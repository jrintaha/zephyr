## drivers/bluetooth/hci/Kconfig.silabs
```kconfig
# Copyright (c) 2025 Silicon Laboratories Inc.
#
# SPDX-License-Identifier: Apache-2.0
menu "EFR32 Bluetooth Controller Configuration"
	depends on BT_SILABS_EFR32

config BT_SILABS_EFR32_HCI_VS
	bool "Silicon Labs vendor specific HCI extensions"
	help
	  Enable Silicon Labs vendor specific HCI extensions.

config BT_SILABS_EFR32_BUFFER_MEMORY
	int "Memory buffer size"
	default 6144
	help
	  Select the size of allocated memory buffer for the Silicon Labs
	  Bluetooth Library. If set too low the capacity of the link layer may
	  suffer.

config BT_SILABS_EFR32_USER_ADVERTISERS
	int "User advertisement sets"
	default 1
	help
	  Number of advertisement sets reserved for the application.

config BT_SILABS_EFR32_ACCEPT_LIST_SIZE
	int "Accept list size"
	default 1
	help
	  Accept list size.

config BT_SILABS_EFR32_COMPLETED_PACKETS_THRESHOLD
	int "Completed packet reporting threshold"
	default 4
	help
	  The number of transmitted air interface ACL packets to trigger the
	  Number Of Completed Packets HCI event.

config BT_SILABS_EFR32_COMPLETED_PACKETS_TIMEOUT
	int "Completed packet report event timeout"
	default 3
	help
	  The maximum number of connection events since the previous Number Of
	  Completed Packets HCI event to trigger reporting of any unreported
	  completed ACL packets.

config BT_SILABS_EFR32_LINK_LAYER_STACK_SIZE
	int "Link layer thread stack size"
	default 1024
	help
	  Link layer thread stack size.

config BT_SILABS_EFR32_MAX_QUEUED_ADV_REPORTS
	int "Maximum queued advertising reports"
	default 10
	help
	  Maximum queued advertising reports.
	  Additional advertising reports are dropped.

config BT_SILABS_EFR32_HIGH_POWER
	bool "Enable high power transmission"
	default n
	help
	  Normally the transmit power is limited to 10 dBm. Enable this option
	  to allow the controller to transmit at higher power levels. Note that
	  this feature is not available on all devices.

config BT_SILABS_EFR32_HIGH_POWER_AFH
	bool "Enable adaptive frequency hopping for high power transmitters"
	default n
	depends on BT_SILABS_EFR32_HIGH_POWER
	help
	  When high power is used, the controller may be required to perform
	  adaptive frequency hopping to comply with regulatory requirements.

config BT_SILABS_EFR32_LL_THREAD_PRIO
	# Hidden option for Co-Operative Link Layer thread priority
	def_int 0

endmenu
```
